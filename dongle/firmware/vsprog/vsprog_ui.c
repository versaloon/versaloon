#include "dal/mal/mal.h"
#include "dal/s6b0724/s6b0724_drv.h"

#include "vsprog_ui.h"

#define VSPUI_CONSOLE_EN						1
#define VSPUI_CONSOLE_CFG_LINE_WRAP				1

#if DAL_S6B0724_EN
static struct s6b0724_drv_interface_t s6b0724_ifs =
{
	0,						// uint8_t ebi_port;
	3,						// uint8_t lcd_index;
	0,						// uint32_t cmd_addr;
	0x400					// uint32_t data_addr;
};
static struct s6b0724_drv_param_t s6b0724_param =
{
	{
		{
			8,				// uint8_t data_width;
			EBI_WAIT_NONE,	// enum wait_signal_t wait_signal;
			0,				// uint32_t mux_addr_mask;
		},					// struct ebi_info_t common_info;
		{
			false,			// bool addr_multiplex;
			
			{
				15,			// uint16_t address_setup_cycle_r;
				0,			// uint16_t address_hold_cycle_r;
				255,		// uint16_t data_setup_cycle_r;
				0,			// uint32_t clock_hz_r;
				15,			// uint16_t address_setup_cycle_w;
				0,			// uint16_t address_hold_cycle_w;
				255,		// uint16_t data_setup_cycle_w;
				0,			// uint32_t clock_hz_w;
			}				// struct ebi_sram_psram_nor_timing_t timing;
		}					// struct ebi_sram_psram_nor_param_t param;
	}						// struct ebi_sram_psram_nor_info_t nor_info;
};
static struct mal_info_t s6b0724_mal =
{
	{
		0,					// uint64_t block_size;
		0,					// uint64_t block_number;
	},						// struct mal_capacity_t capacity;
	NULL,					// void *extra;
	0,						// uint32_t erase_page_size;
	0,						// uint32_t write_page_size;
	0,						// uint32_t read_page_size;
	
	&s6b0724_drv,			// const struct mal_driver_t *driver;
};
static struct dal_info_t s6b0724_dal =
{
	&s6b0724_ifs,			// void *ifs;
	&s6b0724_param,			// void *param;
	NULL,					// void *info;
	&s6b0724_mal,			// void *extra;
};

static uint8_t s6b0724_line_buffer[128];

#if VSPUI_CONSOLE_EN
#define CONSOLE_LINE_NUM		5
static uint8_t s6b0724_console_buffer[CONSOLE_LINE_NUM * 128];
static uint32_t console_cur_char = 0;
#endif

#define FONT_SIZE				6
static uint8_t ascii_array[][FONT_SIZE] =
{
	// " !"#$%&'()*+,-./0123456789:;<=>?@ABCDEFGHIJKLMNOPQRSTUVWXYZ[\]^_`abcdefghijklmnopqrstuvwxyz{|}~ "
	{0x00,0x00,0x00,0x00,0x00,0x00},/*" ",0*/
	{0x00,0x5F,0x00,0x00,0x00,0x00},/*"!",1*/
	{0x00,0x03,0x00,0x03,0x00,0x00},/*""",2*/
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	{0x00,0x00,0x00,0x00,0x00,0x00},/*" ",95*/
};

static void vsprog_ui_set_string_to_buffer(uint8_t *buffer, char *str)
{
	uint64_t bs = s6b0724_mal.capacity.block_size;
	uint16_t i, max = min(strlen(str), bs / FONT_SIZE);
	
	if (buffer != NULL)
	{
		memset(buffer, 0, bs);
		if (str != NULL)
		{
			for (i = 0; i < max; i++)
			{
				if ((str[i] < ' ') || (str[i] > (' ' + dimof(ascii_array))))
				{
					memset(buffer, 0, FONT_SIZE);
				}
				else
				{
					memcpy(buffer, ascii_array[str[i] - ' '], FONT_SIZE);
				}
				buffer += FONT_SIZE;
			}
		}
	}
}

static vsf_err_t vsprog_ui_set_string(uint8_t block, char *str)
{
	vsprog_ui_set_string_to_buffer(s6b0724_line_buffer, str);
	return mal.writeblock(&s6b0724_dal, block * s6b0724_mal.capacity.block_size,
							s6b0724_line_buffer, 1);
}
#endif		// #if DAL_S6B0724_EN

vsf_err_t vsprog_ui_init(void)
{
#if DAL_S6B0724_EN
	uint64_t i;
	
#if VSPUI_CONSOLE_EN
	console_cur_char = 0;
	memset(s6b0724_console_buffer, 0, sizeof(s6b0724_console_buffer));
#endif
	memset(s6b0724_line_buffer, 0, sizeof(s6b0724_line_buffer));
	
	mal.init(&s6b0724_dal);
	for (i = 0; i < s6b0724_mal.capacity.block_number; i++)
	{
		mal.writeblock(&s6b0724_dal, i * s6b0724_mal.capacity.block_size,
						s6b0724_line_buffer, 1);
	}
#endif
	return VSFERR_NONE;
}

vsf_err_t vsprog_ui_fini(void)
{
#if DAL_S6B0724_EN
	return mal.fini(&s6b0724_dal);
#else
	return VSFERR_NONE;
#endif
}

vsf_err_t vsprog_ui_set_title(char *title)
{
#if DAL_S6B0724_EN
	return vsprog_ui_set_string(0, title);
#else
	return VSFERR_NONE;
#endif
}

vsf_err_t vsprog_ui_print(char *str)
{
#if DAL_S6B0724_EN && VSPUI_CONSOLE_EN
	uint64_t i, bs = s6b0724_mal.capacity.block_size;
	uint8_t *base = &s6b0724_console_buffer[(CONSOLE_LINE_NUM - 1) * bs];
	uint8_t *cur_ptr;
	
	if (NULL == str)
	{
		return VSFERR_NONE;
	}
	
	while (str[0] != '\0')
	{
		if (str[0] == '\n')
		{
			// new line
			memcpy(&s6b0724_console_buffer[0], &s6b0724_console_buffer[bs],
					(CONSOLE_LINE_NUM - 1) * bs);
			memset(base, 0, bs);
			console_cur_char = 0;
		}
		else if (str[0] == '\r')
		{
			// return
			console_cur_char = 0;
		}
		else if (str[0] == '\b')
		{
			if (console_cur_char > 0)
			{
				console_cur_char--;
			}
		}
		else
		{
#if VSPUI_CONSOLE_CFG_LINE_WRAP
			if (console_cur_char >= (bs / FONT_SIZE))
			{
				// new line
				memcpy(&s6b0724_console_buffer[0], &s6b0724_console_buffer[bs],
						(CONSOLE_LINE_NUM - 1) * bs);
				memset(base, 0, bs);
				console_cur_char = 0;
			}
#endif
			if (console_cur_char < (bs / FONT_SIZE))
			{
				cur_ptr = base + console_cur_char * FONT_SIZE;
				if ((str[0] < ' ') || (str[0] >= (' ' + dimof(ascii_array))))
				{
					memset(cur_ptr, 0, FONT_SIZE);
				}
				else
				{
					memcpy(cur_ptr, ascii_array[str[0] - ' '], FONT_SIZE);
				}
			}
			console_cur_char++;
		}
		str++;
	}
	
	for (i = 0; i < CONSOLE_LINE_NUM; i++)
	{
		mal.writeblock(&s6b0724_dal, (i + 1) * bs,
						&s6b0724_console_buffer[i * bs], 1);
	}
#endif
	return VSFERR_NONE;
}

vsf_err_t vsprog_ui_set_task(char *task)
{
#if DAL_S6B0724_EN
	return vsprog_ui_set_string(6, task);
#else
	return VSFERR_NONE;
#endif
}

vsf_err_t vsprog_ui_set_progress(uint8_t percentage)
{
#if DAL_S6B0724_EN
	uint64_t bs = s6b0724_mal.capacity.block_size;
	uint64_t bytes = min(percentage * bs / 100, bs), i = 0;
	
	while (i++ < bytes)
	{
		s6b0724_line_buffer[i] = 0xFF;
	}
	while (i++ < bs)
	{
		s6b0724_line_buffer[i] = 0x00;
	}
	return mal.writeblock(&s6b0724_dal, 7 * bs, s6b0724_line_buffer, 1);
#else
	return VSFERR_NONE;
#endif
}
